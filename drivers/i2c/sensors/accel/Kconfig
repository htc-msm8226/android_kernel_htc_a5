## drivers/i2c/sensors/accel/Kconfig
```kconfig
#
# Accelerometer drivers
#
menu "Accelerometers"

config IIO_ST_ACCEL_3AXIS
	tristate "STMicroelectronics accelerometers 3-Axis Driver"
	depends on (I2C || SPI_MASTER) && SYSFS
	select IIO_ST_SENSORS_CORE
	select IIO_ST_ACCEL_I2C_3AXIS if (I2C)
	select IIO_ST_ACCEL_SPI_3AXIS if (SPI_MASTER)
	select IIO_TRIGGERED_BUFFER_ST if (IIO_BUFFER_ST)
	select IIO_ST_ACCEL_BUFFER if (IIO_TRIGGERED_BUFFER_ST)
	help
	  Say yes here to build support for STMicroelectronics accelerometers:
	  LSM303DLH, LSM303DLHC, LIS3DH, LSM330D, LSM330DL, LSM330DLC,
	  LIS331DLH, LSM303DL, LSM303DLM, LSM330.

	  This driver can also be built as a module. If so, will be created
	  these modules:
	  - st_accel (core functions for the driver [it is mandatory]);
	  - st_accel_i2c (necessary for the I2C devices [optional*]);
	  - st_accel_spi (necessary for the SPI devices [optional*]);

	  (*) one of these is necessary to do something.

config IIO_ST_ACCEL_I2C_3AXIS
	tristate
	depends on IIO_ST_ACCEL_3AXIS
	depends on IIO_ST_SENSORS_I2C

config IIO_ST_ACCEL_SPI_3AXIS
	tristate
	depends on IIO_ST_ACCEL_3AXIS
	depends on IIO_ST_SENSORS_SPI

endmenu
```

## drivers/i2c/sensors/iio/Kconfig
```kconfig
#
# Industrial I/O subsytem configuration
#

menuconfig IIO_ST
	tristate "Industrial I/O support"
	depends on GENERIC_HARDIRQS
	help
	  The industrial I/O subsystem provides a unified framework for
	  drivers for many different types of embedded sensors using a
	  number of different physical interfaces (i2c, spi, etc). See
	  drivers/staging/iio/Documentation for more information.
if IIO_ST

config IIO_BUFFER_ST
	bool "Enable buffer support within IIO"
	help
	  Provide core support for various buffer based data
	  acquisition methods.

if IIO_BUFFER_ST

config IIO_TRIGGERED_BUFFER_ST
	tristate
	select IIO_TRIGGER_ST
	select IIO_KFIFO_BUF_ST
	help
	  Provides helper functions for setting up triggered buffers.

config IIO_KFIFO_BUF_ST
	select IIO_TRIGGER_ST
	tristate "Industrial I/O buffering based on kfifo"
	help
	  A simple fifo based on kfifo.  Use this if you want a fifo
	  rather than a ring buffer. Note that this currently provides
	  no buffer events so it is up to userspace to work out how
	  often to read from the buffer.

endif # IIO_BUFFER_ST

config IIO_TRIGGER_ST
	boolean "Enable triggered sampling support"
	help
	  Provides IIO core support for triggers.  Currently these
	  are used to initialize capture of samples to push into
	  ring buffers.  The triggers are effectively a 'capture
	  data now' interrupt.

config IIO_CONSUMERS_PER_TRIGGER_ST
       int "Maximum number of consumers per trigger"
       depends on IIO_TRIGGER_ST
       default "2"
       help
	This value controls the maximum number of consumers that a
	given trigger may handle. Default is 2.

endif # IIO_ST
```
